;/*
; * spi.inc
; *
; *  Created: 12.07.2014 22:34:26
; *   Author: Dominik
; */ 

.SET PORT_SPI	= PORTB
.SET DDR_SPI	= DDRB
.SET SS			= PB0
.SET DD_MISO	= PB3
.SET DD_MOSI	= PB2
.SET DD_SCK		= PB1


.MACRO SPI_OFF
	CBI DDR_SPI, SS
	CBI PORT_SPI, SS
	PUSH R16
	IN R16, DDR_SPI
	CBR R16, (1<<DD_MOSI) | (1<<DD_SCK)
	OUT DDR_SPI, R16
	POP R16
.ENDMACRO

.MACRO SPI_MasterInit ; @0 = SPI_MODE
	SBI DDR_SPI, SS
	SBI PORT_SPI, SS

	PUSH R16
	IN R16, DDR_SPI
	SBR R16, (1<<DD_MOSI) | (1<<DD_SCK)
	OUT DDR_SPI, R16

	IN R16, SPCR

	.IF @0 == 0
	;MODE 0
	CBR R16, (1<<CPOL) | (1<<CPHA) 
	.ENDIF
	.IF @0 == 1
	;MODE 1
	CBR R16, (1<<CPOL)
	SBR R16, (1<<CPHA)
	.ENDIF
	.IF @0 == 2
	;MODE 2
	SBR R16, (1<<CPOL) 
	CBR R16, (1<<CPHA) 
	.ENDIF
	.IF @0 == 3
	;MODE 3
	SBR R16, (1<<CPOL) | (1<<CPHA)
	.ENDIF

	SBR R16, (1<<SPE) | (1<<MSTR) | (0<<SPR0) | (0<<SPR1) | (1<<SPI2X)
	OUT SPCR, R16 

	POP R16
.ENDMACRO

.MACRO SPI_START
	CBI PORT_SPI, SS
.ENDMACRO

.MACRO SPI_STOP
	SBI PORT_SPI, SS
.ENDMACRO

SPI_SEND_BYTE:	;R16 = Data | Return = R0
	PUSH R15
	OUT SPDR, R16
	SPI_SEND_BYTE_WAIT:
		IN R15, SPSR
		SBRS R15, SPIF
	RJMP SPI_SEND_BYTE_WAIT
	IN R0, SPDR
	POP R15
RET


SPI_SEND_BUFF:	; X Pointer, R16 Size
	PUSH R16
	PUSH R15
	SPI_SEND_BUFF_START:
	LD R15, X
	OUT SPDR, R15
		SPI_SEND_BUFF_WAIT:
		IN R15, SPSR
		SBRS R15, SPIF
	RJMP SPI_SEND_BUFF_WAIT
	IN R15, SPDR
	ST X+, R15
	DEC R16
	BRNE SPI_SEND_BUFF_START
	POP R15
	POP R16
RET