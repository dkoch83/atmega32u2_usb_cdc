;/*
;* usb_interrupts.inc
;*
;*  Created: 21.02.2016 19:29:58
;*  Author: Dominik Koch
;*/ 

.ifndef USB_INTERRUPTS_INCLUDE
.set USB_INTERRUPTS_INCLUDE = 1

USB_GEN_INT:	; General USB General Interrupt request
PUSH R16
IN R16, SREG
PUSH R16
PUSH R17
PUSH R18
PUSH R19
	LDS R16, UDINT
	SBRS R16, EORSTI
	RJMP END_OF_RESET
		;Reset EP0
		CLR R16
		LDI R17, (EP_CONTROL)
		LDI R18, EP0_SIZE
		CLR R19
		CALL USB_INIT_EP ;R16 EP_NUM, R17 EP_TYPE + EP_DIR, R18 EP_SIZE, R19 EP_BANKS

		LDS R16, UEIENX
		SBR	R16, (1<<RXSTPE)
		STS UEIENX, R16

		LDS R16, UDINT
		CBR	R16, (1<<EORSTI)
		STS UDINT, R16
	END_OF_RESET:
POP R19
POP R18
POP R17
POP R16
OUT SREG, R16
POP R16
RETI

USB_EP_INT:	; Endpoint USB Endpoint Interrupt request
PUSH R16
IN R16, SREG
PUSH R16
PUSH R17
PUSH R18
PUSH XL
PUSH XH
PUSH YL
PUSH YH
PUSH ZL
PUSH ZH
	LDS R17, UEINT

	SBRS R17, 0	; when EP0 Selected
	RJMP USB_EP_INT_EP0_END
	USB_EP_INT_EP0:
		LDI R16, 0
		STS UENUM, R16
		CALL USB_EP0_CONTROL
	USB_EP_INT_EP0_END:
	
	;EP_CDC_D_OUT CDC_RX
	SBRS R17, 1	; when EP1 Selected
	RJMP USB_EP_INT_EP1_END
	USB_EP_INT_EP1:
		LDI R16, 1
		STS UENUM, R16

		LDS R18, CDC_STATUS
		
		; Nack on Buffer Lock
		SBRC R18, CDC_BUFFER_LOCK_bp
		RJMP USB_EP_INT_EP1_NAK

		; Nack on RX Buffer Full
		SBRC R18, CDC_RX_BUFFER_FULL_bp
		RJMP USB_EP_INT_EP1_NAK

		; Nack on new line in (Enter)
		SBRC R18, CDC_NEW_LN_IN_bp
		RJMP USB_EP_INT_EP1_NAK

		; Recive on RX Ready
		SBRC R18, CDC_RX_bp
		RJMP USB_EP_INT_EP1_REC

		; Default
		RJMP USB_EP_INT_EP1_NAK

		USB_EP_INT_EP1_REC:
			USB_EP_INT_EP1_SEND_WAIT_RX_READY:
				LDS R16, UEINTX
				SBRS R16, RXOUTI
			RJMP USB_EP_INT_EP1_SEND_WAIT_RX_READY
			USB_EP_INT_EP1_SEND_WAIT_RX_READY_END:

			LDS R16, UEINTX
			CBR R16, (1<<RXOUTI)
			STS UEINTX, R16

			; Copy USB Data to Ram Pointer
			LDI XL, LOW(USB_RX_BUFFER_P)
			LDI XH, HIGH(USB_RX_BUFFER_P)
			CALL USB_DATA_TO_BUFFER ; X = RAM_Pointer | Return = R0 = (0 Buffer Free) / (1 Buffer Full)
			
			SBRC R0, 0
			CALL USB_CDC_SET_RX_BUFFER_FULL

			CBR R16, (1<<FIFOCON)
			STS UEINTX, R16
			RJMP USB_EP_INT_END
		USB_EP_INT_EP1_REC_END:

		USB_EP_INT_EP1_NAK:
			CBR R16, (1<<NAKINI)
			STS UEINTX, R16
			RJMP USB_EP_INT_END
		USB_EP_INT_EP1_NAK_END:
	USB_EP_INT_EP1_END:

	;EP_CDC_D_IN CDC_TX
	SBRS R17, 2	; when EP2 Selected
	RJMP USB_EP_INT_EP2_END
	USB_EP_INT_EP2:
		LDI R16, 2
		STS UENUM, R16

		LDS R18, CDC_STATUS

		; Nack on Buffer Lock
		SBRC R18, CDC_BUFFER_LOCK_bp
		RJMP USB_EP_INT_EP2_NAK		
		
		; Send on TX Ready	
		SBRC R18, CDC_TX_bp
		RJMP USB_EP_INT_EP2_SEND
		
		; Default
		RJMP USB_EP_INT_EP2_NAK

		USB_EP_INT_EP2_SEND:
			USB_EP_INT_EP2_SEND_WAIT_TX_READY:
				LDS R16, UEINTX
				SBRS R16, TXINI
				RJMP USB_EP_INT_EP2_SEND_WAIT_TX_READY
			USB_EP_INT_EP2_SEND_WAIT_TX_READY_END:

			;Clear Transmitter Ready Interrupt Flag
			LDS R16, UEINTX
			CBR R16, (1<<TXINI)
			STS UEINTX, R16
		
			;Load TX Pointer
			LDI YL, LOW(USB_TX_BUFFER_P)
			LDI YH, HIGH(USB_TX_BUFFER_P)
			LDD XL, Y+0
			LDD XH, Y+1
			MOVW Y, X

			; Load Buffer Size
			LDD ZL, Y+2
			LDD ZH, Y+3

			; Load Buffer Pos
			LDD XL, Y+4
			LDD XH, Y+5

			PUSH YL
			PUSH YH

			; Set Y to Buffer Pos
			ADIW Y, 6
			ADD YL, XL
			ADC YH, XH

			; Test [Buffer Pos] = [Buffer Size]
			CP  XL, ZL
			CPC XH, ZH
			BRSH USB_EP_INT_EP2_OUT_LOOP_FINISH

			; Test vor Zero Size
			LDI R16, 0x00
			CP  ZL, R16
			CPC ZH, R16
			BREQ USB_EP_INT_EP2_OUT_LOOP_FINISH

			USB_EP_INT_EP2_OUT_LOOP:
				LD R18, Y+
				STS UEDATX, R18
				ADIW X, 1

				CP  XL, ZL
				CPC XH, ZH
				BRSH USB_EP_INT_EP2_OUT_LOOP_FINISH

				LDS R16, UEINTX
				SBRC R16, RWAL
			RJMP USB_EP_INT_EP2_OUT_LOOP
			USB_EP_INT_EP2_OUT_LOOP_END:

			POP YH
			POP YL
			STD Y+4, XL
			STD Y+5, XH

			RJMP USB_EP_INT_EP2_OUT_LOOP_FINISH_END
			USB_EP_INT_EP2_OUT_LOOP_FINISH:
				POP YH
				POP YL
				STD Y+4, XL
				STD Y+5, XH

				CP  XL, ZL
				CPC XH, ZH
				BRNE USB_EP_INT_EP2_OUT_LOOP_FINISH_END

				CALL USB_CDC_STATUS_CLREAR_TX

			USB_EP_INT_EP2_OUT_LOOP_FINISH_END:

			CBR R16, (1<<FIFOCON)
			STS UEINTX, R16
			RJMP USB_EP_INT_END
		USB_EP_INT_EP2_SEND_END:

		USB_EP_INT_EP2_NAK:
			CBR R16, (1<<NAKINI)
			STS UEINTX, R16
			RJMP USB_EP_INT_END
		USB_EP_INT_EP2_NAK_END:
	USB_EP_INT_EP2_END:

	;EP_3 IN CDC Controle
	SBRS R17, 3	; when EP3 Selected
	RJMP USB_EP_INT_EP3_END	 
	USB_EP_INT_EP3:
		LDI R16, 3
		STS UENUM, R16

		LDS R18, CDC_SERIAL_STATE
		LDS R19, CDC_SERIAL_STATE_OLD
		CP R18, R19
		BRNE USB_EP_INT_EP3_IN

		JMP USB_EP_INT_EP3_NACK
		USB_EP_INT_EP3_IN:
			LDS R16, UEINTX
			CBR R16, (1<<TXINI)
			STS UEINTX, R16

				LDI R17, 0b10100001			; bmRequestType
				STS UEDATX, R17	

				LDI R17, SERIAL_STATE		; bRequest
				STS UEDATX, R17	

				LDI R17, 0x00				; wValue
				STS UEDATX, R17
				STS UEDATX, R17	

				LDI R17, 0x00				; wIndex
				STS UEDATX, R17
				STS UEDATX, R17

				LDI R17, 0x02				; wLength
				STS UEDATX, R17	
				LDI R17, 0x00			
				STS UEDATX, R17

				STS UEDATX, R18
				LDI R17, 0x00
				STS UEDATX, R17

				STS CDC_SERIAL_STATE_OLD, R18

			LDS R16, UEINTX
			CBR R16, (1<<FIFOCON)
			STS UEINTX, R16

		RJMP USB_EP_INT_EP3_NACK_END
		USB_EP_INT_EP3_NACK:
			LDS R16, UEINTX
			CBR R16, (1<<NAKINI)
			STS UEINTX, R16
		USB_EP_INT_EP3_NACK_END:

		RJMP USB_EP_INT_END
	USB_EP_INT_EP3_END:

	; Not in use
	SBRS R17, 4	; when EP4 Selected
	RJMP USB_EP_INT_EP4_END
	USB_EP_INT_EP4:
		LDI R16, 4
		STS UENUM, R16

		;LDS R16, UEINTX
		;CBR R16, (1<<TXINI)
		;STS UEINTX, R16

		;CBR R16, (1<<FIFOCON)
		;STS UEINTX, R16

		LDS R16, UEINTX
		CBR R16, (1<<NAKINI)
		STS UEINTX, R16
		RJMP USB_EP_INT_END
	USB_EP_INT_EP4_END:
USB_EP_INT_END:
POP ZH
POP ZL
POP YH
POP YL
POP XH
POP XL
POP R18
POP R17
POP R16
OUT SREG, R16
POP R16
RETI

.ENDIF