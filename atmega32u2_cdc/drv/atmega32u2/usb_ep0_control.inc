;/*
; * usb_ep0_control.inc
; *
; *  Created: 21.01.2016 21:16:20
; *   Author: Dominik Koch
; */ 


.ifndef USB_EP0_CONTROL_INCLUDE
.set USB_EP0_CONTROL_INCLUDE = 1

;####################################################################################################
;										USB_EP0_CONTROL
;####################################################################################################
USB_EP0_CONTROL:
PUSH XL
PUSH XH
PUSH R16
PUSH R17
PUSH R20
PUSH R21
PUSH R22
PUSH ZL
PUSH ZH

	LDI XL, LOW(USB_EP_SETUP_BUFFER)
	LDI XH, HIGH(USB_EP_SETUP_BUFFER)
	CALL USB_DATA_TO_RAM

	; acknowledges request
	USB_SETUP_ACK

	LDS R20, bmRequestType
	ANDI R20, 0x60
	CPI R20, STANDARDREQUEST
	BREQ USB_EP0_CONTROL_STANDARDREQUEST

	RJMP USB_EP0_CONTROL_STANDARDREQUEST_end
	USB_EP0_CONTROL_STANDARDREQUEST:
		LDS R20, bRequest
		;################################################
		CPI R20, CLEAR_FEATURE
		BREQ USB_EP0_CONTROL_CLEAR_FEATURE
		RJMP USB_EP0_CONTROL_CLEAR_FEATURE_END
		USB_EP0_CONTROL_CLEAR_FEATURE:
			RCALL USB_CLEAR_FEATURE
			RCALL USB_EP0_SEND_ZLP
			RJMP USB_EP0_CONTROL_END
		USB_EP0_CONTROL_CLEAR_FEATURE_END:
		;################################################
		CPI R20, GET_STATUS
		BREQ USB_EP0_CONTROL_GET_STATUS
		RJMP USB_EP0_CONTROL_GET_STATUS_END
		USB_EP0_CONTROL_GET_STATUS:
			RCALL USB_GET_STATUS
			; USB_EP0_SEND 2 Bytes
			RCALL USB_EP0_SEND
			RJMP USB_EP0_CONTROL_END
		USB_EP0_CONTROL_GET_STATUS_END:
		;################################################
		CPI R20, SET_ADDRESS
		BREQ USB_EP0_CONTROL_SET_ADDRESS
		RJMP USB_EP0_CONTROL_SET_ADDRESS_END
		USB_EP0_CONTROL_SET_ADDRESS:
			;Set Addresse
			LDS R16, wValueL
			CBR R16, (1<<ADDEN)
			STS UDADDR, R16
			;Send ZLP
			RCALL USB_EP0_SEND_ZLP
			; Enable New Address
			LDS R16, wValueL
			STS UDADDR, R16
			SBR R16, (1<<ADDEN)
			STS UDADDR, R16
		RJMP USB_EP0_CONTROL_END
		USB_EP0_CONTROL_SET_ADDRESS_END:
		;################################################
		CPI R20, GET_DESCRIPTOR
		BREQ USB_EP0_CONTROL_GET_DESCRIPTOR
		RJMP USB_EP0_CONTROL_GET_DESCRIPTOR_END
		USB_EP0_CONTROL_GET_DESCRIPTOR:
			LDS R21, wValueH
			LDS R22, wValueL

			CPI R21, DEVICE_DESCRIPTOR
			BREQ USB_EP0_CONTROL_GET_DESCRIPTOR_DEVICE_DESCRIPTOR
			RJMP USB_EP0_CONTROL_GET_DESCRIPTOR_DEVICE_DESCRIPTOR_END
			USB_EP0_CONTROL_GET_DESCRIPTOR_DEVICE_DESCRIPTOR:
				LDI ZL, LOW(DEV_DES)
				LDI ZH, HIGH(DEV_DES)

				LDI XL, 0x12 
				LDI XH, 0x00
				RCALL USB_PGM_SEND_DES ; Z = Pointer Descriptor | X = Descriptor Size 

				RJMP USB_EP0_CONTROL_END
			USB_EP0_CONTROL_GET_DESCRIPTOR_DEVICE_DESCRIPTOR_END:
			;################################################
			CPI R21, CONFIG_DESCRIPTOR
			BREQ USB_EP0_CONTROL_GET_DESCRIPTOR_CONFIG_DESCRIPTOR
			RJMP USB_EP0_CONTROL_GET_DESCRIPTOR_CONFIG_DESCRIPTOR_END
			USB_EP0_CONTROL_GET_DESCRIPTOR_CONFIG_DESCRIPTOR:
				LDI ZL, LOW(CONF_DES) 
				LDI ZH, HIGH(CONF_DES)

				LDI XL, LOW(62) 
				LDI XH, HIGH(62)
				RCALL USB_PGM_SEND_DES ; Z = Pointer Descriptor | X = Descriptor Size 

				RJMP USB_EP0_CONTROL_END
			USB_EP0_CONTROL_GET_DESCRIPTOR_CONFIG_DESCRIPTOR_END:
			;################################################
			CPI R21, STRING_DESCRIPTOR
			BREQ USB_EP0_CONTROL_GET_DESCRIPTOR_STRING_DESCRIPTOR
			RJMP USB_EP0_CONTROL_GET_DESCRIPTOR_STRING_DESCRIPTOR_END
			USB_EP0_CONTROL_GET_DESCRIPTOR_STRING_DESCRIPTOR:
				CPI R22, 0x00 ; Index 0
				BREQ USB_EP0_CONTROL_GET_DESCRIPTOR_STRING_DESCRIPTOR0
				RJMP USB_EP0_CONTROL_GET_DESCRIPTOR_STRING_DESCRIPTOR0_END
				USB_EP0_CONTROL_GET_DESCRIPTOR_STRING_DESCRIPTOR0:
					LDI ZL, LOW(LANG_DES) 
					LDI ZH, HIGH(LANG_DES)

					LDI XL, LOW(LANG_DES_LEN) 
					LDI XH, HIGH(LANG_DES_LEN)
					RCALL USB_PGM_SEND_DES ; Z = Pointer Descriptor | X = Descriptor Size 
				
					RJMP USB_EP0_CONTROL_END
				USB_EP0_CONTROL_GET_DESCRIPTOR_STRING_DESCRIPTOR0_END:
				;################################################
				CPI R22, 0x01 ; Index 1
				BREQ USB_EP0_CONTROL_GET_DESCRIPTOR_STRING_DESCRIPTOR1
				RJMP USB_EP0_CONTROL_GET_DESCRIPTOR_STRING_DESCRIPTOR1_END
				USB_EP0_CONTROL_GET_DESCRIPTOR_STRING_DESCRIPTOR1:
					LDI ZL, LOW(STRING_DES_1) 
					LDI ZH, HIGH(STRING_DES_1)

					LDI XL, LOW(STRING_DES_1_LEN) 
					LDI XH, HIGH(STRING_DES_1_LEN)
					RCALL USB_PGM_SEND_DES ; Z = Pointer Descriptor | X = Descriptor Size 
				
					RJMP USB_EP0_CONTROL_END
				USB_EP0_CONTROL_GET_DESCRIPTOR_STRING_DESCRIPTOR1_END:
				;################################################
				CPI R22, 0x02 ; Index 2
				BREQ USB_EP0_CONTROL_GET_DESCRIPTOR_STRING_DESCRIPTOR2
				RJMP USB_EP0_CONTROL_GET_DESCRIPTOR_STRING_DESCRIPTOR2_END
				USB_EP0_CONTROL_GET_DESCRIPTOR_STRING_DESCRIPTOR2:
					LDI ZL, LOW(STRING_DES_2) 
					LDI ZH, HIGH(STRING_DES_2)

					LDI XL, LOW(STRING_DES_2_LEN) 
					LDI XH, HIGH(STRING_DES_2_LEN)
					RCALL USB_PGM_SEND_DES ; Z = Pointer Descriptor | X = Descriptor Size 
				
					RJMP USB_EP0_CONTROL_END
				USB_EP0_CONTROL_GET_DESCRIPTOR_STRING_DESCRIPTOR2_END:
				;################################################
				CPI R22, 0x03 ; Index 3
				BREQ USB_EP0_CONTROL_GET_DESCRIPTOR_STRING_DESCRIPTOR3
				RJMP USB_EP0_CONTROL_GET_DESCRIPTOR_STRING_DESCRIPTOR3_END
				USB_EP0_CONTROL_GET_DESCRIPTOR_STRING_DESCRIPTOR3:
					LDI ZL, LOW(STRING_DES_3) 
					LDI ZH, HIGH(STRING_DES_3)

					LDI XL, LOW(STRING_DES_3_LEN) 
					LDI XH, HIGH(STRING_DES_3_LEN)
					RCALL USB_PGM_SEND_DES ; Z = Pointer Descriptor | X = Descriptor Size 
				
					RJMP USB_EP0_CONTROL_END
				USB_EP0_CONTROL_GET_DESCRIPTOR_STRING_DESCRIPTOR3_END:
			USB_EP0_CONTROL_GET_DESCRIPTOR_STRING_DESCRIPTOR_END:
		USB_EP0_CONTROL_GET_DESCRIPTOR_END:
		;################################################
		CPI R20, SET_CONFIGURATION
		BREQ USB_EP0_CONTROL_SET_CONFIGURATION
		RJMP USB_EP0_CONTROL_SET_CONFIGURATION_END
		USB_EP0_CONTROL_SET_CONFIGURATION:
			LDS R16, wValueL
			STS USB_CONFIG, R16
			RCALL USB_SET_CONFIGURATION
			RCALL USB_EP0_SEND_ZLP
			RJMP USB_EP0_CONTROL_END
		USB_EP0_CONTROL_SET_CONFIGURATION_END:
		;################################################
		CPI R20, GET_CONFIGURATION
		BREQ USB_EP0_CONTROL_GET_CONFIGURATION
		RJMP USB_EP0_CONTROL_GET_CONFIGURATION_END
		USB_EP0_CONTROL_GET_CONFIGURATION:
			LDS R16, USB_CONFIG
			STS UEDATX, R16
			RCALL USB_EP0_SEND
			RJMP USB_EP0_CONTROL_END
		USB_EP0_CONTROL_GET_CONFIGURATION_END:
		;################################################
		CPI R20, SET_DESCRIPTOR
		BREQ USB_EP0_CONTROL_SET_DESCRIPTOR
		RJMP USB_EP0_CONTROL_SET_DESCRIPTOR_END
		USB_EP0_CONTROL_SET_DESCRIPTOR:
			RJMP USB_EP0_CONTROL_STALL
		USB_EP0_CONTROL_SET_DESCRIPTOR_END:
		;################################################
		CPI R20, GET_INTERFACE
		BREQ USB_EP0_CONTROL_GET_INTERFACE
		RJMP USB_EP0_CONTROL_GET_INTERFACE_END
		USB_EP0_CONTROL_GET_INTERFACE:
			LDI XL, LOW(USB_INTERF_ALT_CONF)
			LDI XH, HIGH(USB_INTERF_ALT_CONF)

			LDS R16, wIndexL
			ADD XL, R16
			CLR R16
			ADC XH, R16

			LD R16, X
			STS UEDATX, R16

			RCALL USB_EP0_SEND
			RJMP USB_EP0_CONTROL_END
		USB_EP0_CONTROL_GET_INTERFACE_END:
		;################################################
		CPI R20, SET_INTERFACE
		BREQ USB_EP0_CONTROL_SET_INTERFACE
		RJMP USB_EP0_CONTROL_SET_INTERFACE_END
		USB_EP0_CONTROL_SET_INTERFACE:
			LDS R16, wValueL ; Interface-conf-ID 
			LDS R17, wIndexL ; Interface-ID

			LDI XL, LOW(USB_INTERF_ALT_CONF)
			LDI XH, HIGH(USB_INTERF_ALT_CONF)
			ADD XL, R17
			CLR R17
			ADC XH, R17

			ST X, R16
			LDS R16, wIndexL ; Interface-ID
			STS USB_INTERF_ALT_CONF, R16
			RCALL USB_SET_INTERFACE
			RCALL USB_EP0_SEND_ZLP
			RJMP USB_EP0_CONTROL_END
		USB_EP0_CONTROL_SET_INTERFACE_END:
		;################################################
		CPI R20, SET_FEATURE 
		BREQ USB_EP0_CONTROL_SET_FEATURE 
		RJMP USB_EP0_CONTROL_SET_FEATURE_END
		USB_EP0_CONTROL_SET_FEATURE:
			RCALL USB_SET_FEATURE
			RJMP USB_EP0_CONTROL_END
		USB_EP0_CONTROL_SET_FEATURE_END:
		;################################################
		USB_EP0_CONTROL_ELSE:
			RJMP USB_EP0_CONTROL_STALL
		USB_EP0_CONTROL_ELSE_END:
		;################################################
	USB_EP0_CONTROL_STANDARDREQUEST_end:
	;################################################

	LDS R20, bmRequestType
	ANDI R20, 0x60
	CPI R20, CLASSREQUEST
	BREQ USB_EP0_CONTROL_CLASSREQUEST

	RJMP USB_EP0_CONTROL_CLASSREQUEST_END
	USB_EP0_CONTROL_CLASSREQUEST:
	LDS R20, bRequest
		;################################################
.ifdef USB_CDC_INCLUDE
		;################################################
		CPI R20, SEND_ENCAPSULATED_COMMAND
		BREQ USB_EP0_CONTROL_SEND_ENCAPSULATED_COMMAND
		RJMP USB_EP0_CONTROL_SEND_ENCAPSULATED_COMMAND_END
		USB_EP0_CONTROL_SEND_ENCAPSULATED_COMMAND:
			;CALL USB_CDC_SEND_ENCAPSULATED_COMMAND
			;RJMP USB_EP0_CONTROL_END
			RJMP USB_EP0_CONTROL_STALL
		USB_EP0_CONTROL_SEND_ENCAPSULATED_COMMAND_END:
		;################################################
		CPI R20, GET_ENCAPSULATED_RESPONSE
		BREQ USB_EP0_CONTROL_GET_ENCAPSULATED_RESPONSE
		RJMP USB_EP0_CONTROL_GET_ENCAPSULATED_RESPONSE_END
		USB_EP0_CONTROL_GET_ENCAPSULATED_RESPONSE:
			;CALL USB_CDC_GET_ENCAPSULATED_RESPONSE
			;RJMP USB_EP0_CONTROL_END
			RJMP USB_EP0_CONTROL_STALL
		USB_EP0_CONTROL_GET_ENCAPSULATED_RESPONSE_END:
		;################################################
		CPI R20, SET_LINE_CODING
		BREQ USB_EP0_CONTROL_SET_LINE_CODING 
		RJMP USB_EP0_CONTROL_SET_LINE_CODING_END
		USB_EP0_CONTROL_SET_LINE_CODING:
			RCALL USB_CDC_SET_LINE_CODING
			; Flush Buffer
				CALL USB_CDC_FLUSH_RX_BUFFER
				CALL USB_CDC_FLUSH_TX_BUFFER
			; Flush Buffer End
			; Reset Serial States
				LDI R16, 0x00
				SBR R16, CDC_DSR_bm
				STS CDC_SERIAL_STATE, R16
				LDI R16, 0xFF
				STS CDC_SERIAL_STATE_OLD, R16
			; Reset Serial States end	
			RJMP USB_EP0_CONTROL_END
		USB_EP0_CONTROL_SET_LINE_CODING_END:
		;################################################
		CPI R20, GET_LINE_CODING
		BREQ USB_EP0_CONTROL_GET_LINE_CODING 
		RJMP USB_EP0_CONTROL_GET_LINE_CODING_END
		USB_EP0_CONTROL_GET_LINE_CODING:
			RCALL USB_CDC_GET_LINE_CODING
			RJMP USB_EP0_CONTROL_END
		USB_EP0_CONTROL_GET_LINE_CODING_END:
		;################################################
		CPI R20, SET_CONTROL_LINE_STATE
		BREQ USB_EP0_CONTROL_SET_CONTROL_LINE_STATE
		RJMP USB_EP0_CONTROL_SET_CONTROL_LINE_STATE_END
		USB_EP0_CONTROL_SET_CONTROL_LINE_STATE:
			; Send ZLP
			; RCALL USB_EP0_SEND_ZLP
			CALL USB_CDC_SET_CONTROL_LINE_STATE
			RJMP USB_EP0_CONTROL_END
		USB_EP0_CONTROL_SET_CONTROL_LINE_STATE_END:
.endif
		;################################################
	USB_EP0_CONTROL_CLASSREQUEST_END:
	;################################################

USB_EP0_CONTROL_STALL:
	USB_SETUP_STALL
USB_EP0_CONTROL_END:
POP ZH
POP ZL
POP R22
POP R21
POP R20
POP R17
POP R16
POP XH
POP XL
RET

;####################################################################################################
;											USB_GET_STATUS
;####################################################################################################
USB_GET_STATUS:
PUSH R20
PUSH R18
	LDS R20, bmRequestType
	ANDI R20, 0b00011111
	;#############################
	CPI R20, RequestType_DEVICE
	BREQ USB_GET_STATUS_DEVICE
	RJMP USB_GET_STATUS_DEVICE_END
	USB_GET_STATUS_DEVICE:
		CLR R18
		SBR R18, (0<<0) ; Bus Powered
		;SBR R18, (1<<0) ; Self Powered
		.IF USB_REMOTE_WAKEUP == 0
			SBR R18, (0<<1) ; No Remote Wakeup
		.ELSE 
			LDI R18, (1<<1) ; Remote Wakeup
		.ENDIF
		STS UEDATX, R18
		CLR R18
		STS UEDATX, R18
		RJMP USB_GET_STATUS_END
	USB_GET_STATUS_DEVICE_END:
	;#############################
	CPI R20, RequestType_INTERFACE
	BREQ USB_GET_STATUS_INTERFACE
	RJMP USB_GET_STATUS_INTERFACE_END
	USB_GET_STATUS_INTERFACE:
		CLR R18
		STS UEDATX, R18
		STS UEDATX, R18
		RJMP USB_GET_STATUS_END
	USB_GET_STATUS_INTERFACE_END:
	;#############################
	CPI R20, RequestType_ENDPOINT
	BREQ USB_GET_STATUS_ENDPOINT
	RJMP USB_GET_STATUS_ENDPOINT_END
	USB_GET_STATUS_ENDPOINT:
		PUSH R16
		PUSH R17
			LDS R16, wIndexL
			CBR R16, 0x80
			STS UENUM, R16
			
			LDS R17, UECONX
			CLR R18
			STS UEDATX, R18
			SBRC R17, 7
			LDI R18, 0x01 ; STALLED
			STS UEDATX, R18

			CLR R16
			STS UENUM, R16
		POP R17
		POP R16
		RJMP USB_GET_STATUS_END
	USB_GET_STATUS_ENDPOINT_END:
	;#############################
	CPI R20, RequestType_OTHER
	BREQ USB_GET_STATUS_OTHER
	RJMP USB_GET_STATUS_OTHER_END
	USB_GET_STATUS_OTHER:
		CLR R18
		STS UEDATX, R18
		STS UEDATX, R18
		RJMP USB_GET_STATUS_END
	USB_GET_STATUS_OTHER_END:
	;#############################
USB_GET_STATUS_END:
POP R18
POP R20
RET
;####################################################################################################
;											USB_SET_CONFIGURATION
;####################################################################################################
USB_SET_CONFIGURATION:
PUSH R16
PUSH R17
PUSH R18
PUSH R19
PUSH XL
PUSH XH
	LDS R16, wValueL
	STS USB_CONFIG, R16
	
.IF USB_CDC_ENABLE == 1
	CPI R16, USB_CDC_CONFIGURATION_NUM
	BREQ USB_SET_CONFIGURATION_1
	RJMP USB_SET_CONFIGURATION_1_END
	USB_SET_CONFIGURATION_1:
		RCALL USB_CLEAR_EPS
		
		; EP_CDC_D_OUT Setup
		LDI R16, EP_CDC_D_OUT
		LDI R17, EP_BULK
		LDI R18, EP_CDC_D_SIZE
		CLR R19
		RCALL USB_INIT_EP ;R16 EP_NUM, R17 EP_TYPE, R18 EP_SIZE, R19 EP_BANKS	
		
		; EP_CDC_D_IN Setup
		LDI R16, EP_CDC_D_IN
		LDI R17, EP_BULK
		LDI R18, EP_CDC_D_SIZE
		CLR R19
		RCALL USB_INIT_EP ;R16 EP_NUM, R17 EP_TYPE, R18 EP_SIZE, R19 EP_BANKS

		; EP_CDC_C_IN Setup
		LDI R16, EP_CDC_C_IN
		LDI R17, EP_INTERRUPT
		LDI R18, EP_CDC_C_SIZE
		CLR R19
		RCALL USB_INIT_EP ;R16 EP_NUM, R17 EP_TYPE, R18 EP_SIZE, R19 EP_BANKS	
			
	RJMP USB_SET_CONFIGURATION_END
	USB_SET_CONFIGURATION_1_END:
.ENDIF
USB_SET_CONFIGURATION_END:
;Set EP0
CLR R16
STS UENUM, R16

POP XH
POP XL
POP R19
POP R18
POP R17
POP R16
RET
;####################################################################################################
;										USB_SET_INTERFACE
;####################################################################################################
USB_SET_INTERFACE: ; R16 =  Interface-ID 

USB_SET_INTERFACE_END:
RET
;####################################################################################################
;											USB_SET_FEATURE
;####################################################################################################
USB_SET_FEATURE:
PUSH R16
PUSH R20
PUSH R21
	LDS R20, bmRequestType
	LDS R21, wValueL
	ANDI R20, 0b00011111
	;#############################
	CPI R20, RequestType_DEVICE
	BREQ USB_SET_FEATURE_DEVICE
	RJMP USB_SET_FEATURE_DEVICE_END
	USB_SET_FEATURE_DEVICE:
		CPI R21, 1
		BREQ USB_SET_FEATURE_DEVICE_REMOTE_WAKEUP
		RJMP USB_SET_FEATURE_DEVICE_REMOTE_WAKEUP_END
		USB_SET_FEATURE_DEVICE_REMOTE_WAKEUP:
			;RJMP USB_SET_FEATURE_END
		USB_SET_FEATURE_DEVICE_REMOTE_WAKEUP_END:
		RJMP USB_SET_FEATURE_STALL
	USB_SET_FEATURE_DEVICE_END:
	;#############################
	CPI R20, RequestType_INTERFACE
	RJMP USB_SET_FEATURE_INTERFACE_END
	USB_SET_FEATURE_INTERFACE:
		RJMP USB_SET_FEATURE_STALL
	USB_SET_FEATURE_INTERFACE_END:
	;#############################
	CPI R20, RequestType_ENDPOINT
	RJMP USB_SET_FEATURE_ENDPOINT_END
	USB_SET_FEATURE_ENDPOINT:
		CPI R21, 0
		BREQ USB_SET_FEATURE_ENDPOINT_HALT
		RJMP USB_SET_FEATURE_ENDPOINT_HALT_END
		USB_SET_FEATURE_ENDPOINT_HALT:
			LDS R16, wIndexL
			CBR R16, 0x80
			STS UENUM, R16

			LDS R16, UECONX
			SBR R16, (1<<STALLRQ)
			STS UECONX, R16

			CLR R16
			STS UENUM, R16

			RJMP USB_SET_FEATURE_END
		USB_SET_FEATURE_ENDPOINT_HALT_END:
		LDI R16, 0x80
		RJMP USB_SET_FEATURE_STALL
	USB_SET_FEATURE_ENDPOINT_END:

	RJMP USB_SET_FEATURE_STALL_END
	USB_SET_FEATURE_STALL:
		USB_SETUP_STALL
	USB_SET_FEATURE_STALL_END:
USB_SET_FEATURE_END:
POP R21
POP R20
POP R16
RET
;####################################################################################################
;										USB_CLEAR_FEATURE
;####################################################################################################
USB_CLEAR_FEATURE:
PUSH R16
PUSH R20
PUSH R21
	LDS R20, bmRequestType
	LDS R21, wValueL
	ANDI R20, 0b00011111
	;#############################
	CPI R20, RequestType_DEVICE
	BREQ USB_CLEAR_FEATURE_DEVICE
	RJMP USB_CLEAR_FEATURE_DEVICE_END
	USB_CLEAR_FEATURE_DEVICE:
		CPI R21, 1
		BREQ USB_CLEAR_FEATURE_DEVICE_REMOTE_WAKEUP
		RJMP USB_CLEAR_FEATURE_DEVICE_REMOTE_WAKEUP_END
		USB_CLEAR_FEATURE_DEVICE_REMOTE_WAKEUP:
			;RJMP USB_CLEAR_FEATURE_END
		USB_CLEAR_FEATURE_DEVICE_REMOTE_WAKEUP_END:
		RJMP USB_CLEAR_FEATURE_STALL
	USB_CLEAR_FEATURE_DEVICE_END:
	;#############################
	CPI R20, RequestType_INTERFACE
	RJMP USB_CLEAR_FEATURE_INTERFACE_END
	USB_CLEAR_FEATURE_INTERFACE:
		RJMP USB_CLEAR_FEATURE_STALL
	USB_CLEAR_FEATURE_INTERFACE_END:
	;#############################
	CPI R20, RequestType_ENDPOINT
	RJMP USB_SET_FEATURE_ENDPOINT_END
	USB_CLEAR_FEATURE_ENDPOINT:
		CPI R21, 0
		BREQ USB_CLEAR_FEATURE_ENDPOINT_HALT
		RJMP USB_CLEAR_FEATURE_ENDPOINT_HALT_END
		USB_CLEAR_FEATURE_ENDPOINT_HALT:
			LDS R16, wIndexL 
			CBR R16, 0x80
			STS UENUM, R16

			LDS R16, UECONX
			SBR R16, (1<<STALLRQC) | (1<<RSTDT)  
			STS UECONX, R16

			CLR R16
			STS UENUM, R16

			RJMP USB_SET_FEATURE_END
		USB_CLEAR_FEATURE_ENDPOINT_HALT_END:
		RJMP USB_CLEAR_FEATURE_STALL
	USB_CLEAR_FEATURE_ENDPOINT_END:

	RJMP USB_CLEAR_FEATURE_STALL_END
	USB_CLEAR_FEATURE_STALL:
		USB_SETUP_STALL
	USB_CLEAR_FEATURE_STALL_END:
USB_CLEAR_FEATURE_END:
POP R21
POP R20
POP R16
RET
;####################################################################################################
;
;####################################################################################################
.ENDIF

