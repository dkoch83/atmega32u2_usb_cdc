;/*
; * usart_spi.inc
; *
; *  Created: 07.05.2016 17:27:58
; *   Author: Dominik Koch
; */ 

.ifndef usart_spi_INCLUDE
.set usart_spi_INCLUDE = 1

; OSC 16000000 | BAUT = 4000000
; BAUD = fOSC / (2*(UBRRn + 1))
.SET USART_SPI_UBRR1H =	0x00 
.SET USART_SPI_UBRR1L = 0x04

.SET XCK1_DDR	= DDRD
.SET XCK1		= PD5

.SET RXD1_DDR	= DDRD
.SET RXD1		= PD2

.SET TXD1_DDR	= DDRD
.SET TXD1		= PD3

.SET CS1_DDR	= DDRD
.SET CS1_PORT	= PORTD
.SET CS1		= PD4

.SET UCPHA1		= UCSZ10
.SET UDORD1		= UCSZ11

.MACRO USART_SPI_START
	CBI CS1_PORT, CS1
.ENDMACRO

.MACRO USART_SPI_STOP
	SBI CS1_PORT, CS1
.ENDMACRO

.MACRO USART_SPI_SET_MSBit
PUSH R16
	LDS R16, UCSR1C
	CBR R16, 2
	STS UCSR1C, R16
POP R16
.ENDMACRO

.MACRO USART_SPI_SET_LSBit
PUSH R16
	LDS R16, UCSR1C
	SBR R16, 2
	STS UCSR1C, R16
POP R16
.ENDMACRO
;#########################################################
;					USART_SPI_INIT
;#########################################################
USART_SPI_INIT:	; R16 = SPI_MODE (0 1 2 3)
PUSH R16
PUSH R17
PUSH R18
	CLR R18
	STS UBRR1H, R18
	STS UBRR1L, R18
	; Setting the port pin
	;Set Input
	CBI RXD1_DDR, RXD1
	;Set Output
	SBI XCK1_DDR, XCK1
	SBI TXD1_DDR, TXD1
	SBI CS1_DDR,  CS1

	; Enable Master Mode and Select SPI Mode
	CPI R16, 0x00
	BREQ USART_SPI_INIT_MODE0

	CPI R16, 0x01
	BREQ USART_SPI_INIT_MODE1

	CPI R16, 0x02
	BREQ USART_SPI_INIT_MODE2

	CPI R16, 0x03
	BREQ USART_SPI_INIT_MODE3

	CPI R16, 0x04
	BRSH USART_SPI_INIT_MODE3

	USART_SPI_INIT_MODE0:
	; Set MSPI mode of operation and SPI data mode 0.
	LDI R18, (1<<UMSEL11)|(1<<UMSEL10)|(0<<UCPHA1)|(0<<UCPOL1)
	RJMP USART_SPI_INIT_MODE_END

	USART_SPI_INIT_MODE1:
	; Set MSPI mode of operation and SPI data mode 1.
	LDI R18, (1<<UMSEL11)|(1<<UMSEL10)|(1<<UCPHA1)|(0<<UCPOL1)
	RJMP USART_SPI_INIT_MODE_END

	USART_SPI_INIT_MODE2:
	; Set MSPI mode of operation and SPI data mode 2.
	LDI R18, (1<<UMSEL11)|(1<<UMSEL10)|(0<<UCPHA1)|(1<<UCPOL1)
	RJMP USART_SPI_INIT_MODE_END

	USART_SPI_INIT_MODE3:
	; Set MSPI mode of operation and SPI data mode 3.
	LDI R18, (1<<UMSEL11)|(1<<UMSEL10)|(1<<UCPHA1)|(1<<UCPOL1)
	
	USART_SPI_INIT_MODE_END:
	STS UCSR1C, R18
	
	; Enable receiver and transmitter.
	LDI R18, (1<<RXEN1)|(1<<TXEN1)
	STS UCSR1B, R18

	; Set baud rate.
	LDI R17, USART_SPI_UBRR1H
	LDI R18, USART_SPI_UBRR1L
	STS UBRR1H, R17
	STS UBRR1L, R18	

	USART_SPI_STOP
USART_SPI_INIT_END:
POP R18
POP R17
POP R16
RET
;#########################################################
;					USART_SPI_SEND_BYTE
;#########################################################
USART_SPI_SEND_BYTE: ; R16 = Data | Return = R0
PUSH R15
	USART_SPI_SEND_BYTE_WAIT_READY:
		LDS R15, UCSR1A
		SBRS R15, UDRE1
	RJMP USART_SPI_SEND_BYTE_WAIT_READY

	STS UDR1, R16

	USART_SPI_SEND_BYTE_WAIT_RECIVE:
		LDS R15, UCSR1A
		SBRS R15, RXC1
	RJMP USART_SPI_SEND_BYTE_WAIT_RECIVE

	LDS R0, UDR1
USART_SPI_SEND_BYTE_END:
POP R15
RET

.endif