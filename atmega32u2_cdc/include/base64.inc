;/*
;* base64_enc.inc
;*
;*  Created: 16.09.2014 20:42:20
;*   Author: Dominik
;*/

;	.SET BASE64_DEC_ENABLE = 1
;	.SET BASE64_ENC_ENABLE = 1
 
; RFC 3548 
;                   Table 1: The Base 64 Alphabet
;
;      Value Encoding  Value Encoding  Value Encoding  Value Encoding
;          0 A            17 R            34 i            51 z
;          1 B            18 S            35 j            52 0
;          2 C            19 T            36 k            53 1
;          3 D            20 U            37 l            54 2
;          4 E            21 V            38 m            55 3
;          5 F            22 W            39 n            56 4
;          6 G            23 X            40 o            57 5
;          7 H            24 Y            41 p            58 6
;          8 I            25 Z            42 q            59 7
;          9 J            26 a            43 r            60 8
;         10 K            27 b            44 s            61 9
;         11 L            28 c            45 t            62 +
;         12 M            29 d            46 u            63 /
;         13 N            30 e            47 v
;         14 O            31 f            48 w         (pad) =
;         15 P            32 g            49 x
;         16 Q            33 h            50 y
;
.ifndef base64_include
.set base64_include = 1

.CSEG
BASE64_CODE: .DB "ABCDEFGHIJKLMNOPQRSTUVWXYZabcdefghijklmnopqrstuvwxyz0123456789+/"

; String Pointer = Pointer to a NULL Terminated String
;
; Size OUT BUFFER = ((STRLEN / 6) * 8) + 1 
BASE64_ENC_URL: ; XH:XL = String Pointer, YH:YL = OUT BUFFER
PUSH XH
PUSH XL
PUSH YH
PUSH YL
PUSH ZH
PUSH ZL
PUSH R21
PUSH R22
PUSH R23
PUSH R24
PUSH R25	
	
	LDI ZH, HIGH(BASE64_CODE)
	LDI ZL, LOW(BASE64_CODE)

	LDI R21, 3
	LDI R22, 6
	LDI R23, 0
	CLR R25

	BASE64_ENC_URL_LOOP1:

		CPI R21, 0x00
		BRNE BASE64_ENC_URL_PADCOUNT_RESET2
			LDI R21, 3
		BASE64_ENC_URL_PADCOUNT_RESET2:

		CPI R22, 0x00
		BRNE BASE64_ENC_URL_WRITEBYTE_END
				CLR R16
				MOV R17, R25
				RCALL PGM_READ_BYTE ;ZH:ZL = Pointer Address, R16:R17 = Byte Adress
				ST Y+, R0
				DEC R21
			LDI R22, 6
			CLR R25
		BASE64_ENC_URL_WRITEBYTE_END:

		CPI R23, 0x00
		BRNE BASE64_ENC_URL_READBYTE_END
		LD R24, X+
		CPI R24, 0x00
		BRNE BASE64_ENC_URL_STRNOEND
			
			CPI R22, 6
			BREQ BASE64_ENC_URL_NOLAST
			BASE64_ENC_URL_LAST:
				LSL R25
				DEC R22		
			BRNE BASE64_ENC_URL_LAST
				CLR R16
				MOV R17, R25
				RCALL PGM_READ_BYTE ;ZH:ZL = Pointer Address, R16:R17 = Byte Adress
				ST Y+, R0
		BASE64_ENC_URL_NOLAST:
				DEC R21
		RJMP BASE64_ENC_URL_END
		BASE64_ENC_URL_STRNOEND:
		LDI R23, 8
		BASE64_ENC_URL_READBYTE_END:

		; Schift
		LSL R24
		ROL R25

		DEC R23
		DEC R22
	RJMP BASE64_ENC_URL_LOOP1
	BASE64_ENC_URL_END:

	CPI R21, 0x00
	BRLO BASE64_ENC_URL_PADD_LOOP_END
	BREQ BASE64_ENC_URL_PADD_LOOP_END
	BRMI BASE64_ENC_URL_PADD_LOOP_END
	BASE64_ENC_URL_PADD_LOOP:
		LDI R24, '='
		ST Y+, R24
		DEC R21
	BRNE BASE64_ENC_URL_PADD_LOOP
	BASE64_ENC_URL_PADD_LOOP_END:
	LDI R24, 0x00
	ST Y+, R24

POP R25
POP R24
POP R23
POP R22
POP R21
POP ZL
POP ZH
POP YL
POP YH
POP XL
POP XH
RET

; From Buffer block size must be divisible by 4
;
; OUT BUFFER SIZE must ((BUFFER FROM SIZE / 3) * 4) + 1
;
BASE64_ENC_BLOCK: ; XH:XL = Pointer FROM BUFFER, YH:YL = Pointer OUT BUFFER, R16:R17 = BUFFER FROM SIZE
PUSH XH
PUSH XL
PUSH YH
PUSH YL
PUSH ZH
PUSH ZL
PUSH R16
PUSH R17
PUSH R20
PUSH R21
PUSH R22
PUSH R23
PUSH R24
PUSH R25	
	
	LDI R20, 0x00
	LDI R21, 0x01

	CLR R0
	CLR R1

	LDI ZH, HIGH(BASE64_CODE)
	LDI ZL, LOW(BASE64_CODE)

	LDI R19, 3
	LDI R22, 6
	LDI R23, 0
	CLR R25

	BASE64_ENC_BLOCK_LOOP1:
		CPI R22, 0x00
		BRNE BASE64_ENC_BLOCK_WRITEBYTE_END
			PUSH R16
			PUSH R17
			PUSH R0
			PUSH R1
				CLR R16
				MOV R17, R25
				RCALL PGM_READ_BYTE ;ZH:ZL = Pointer Address, R16:R17 = Byte Adress
				ST Y+, R0
			POP R1
			POP R0
			POP R17
			POP R16
			LDI R22, 6
			CLR R25
			ADD R1, R21
			ADC R0, R20
		BASE64_ENC_BLOCK_WRITEBYTE_END:

		CPI R23, 0x00
		BRNE BASE64_ENC_BLOCK_READBYTE_END
			LD R24, X+
			LDI R23, 8

			LDI R20, 0x00
			LDI R21, 0x01

			SUB R17, R21
			SBC R16, R20
			CP  R17, R20
			CPC R16, R20
			BREQ BASE64_ENC_BLOCK_END
		BASE64_ENC_BLOCK_READBYTE_END:

		; Schift
		LSL R24
		ROL R25

		DEC R23
		DEC R22
	RJMP BASE64_ENC_BLOCK_LOOP1
	BASE64_ENC_BLOCK_END:

POP R25
POP R24
POP R23
POP R22
POP R21
POP R20
POP R17
POP R16
POP ZL
POP ZH
POP YL
POP YH
POP XL
POP XH
RET

BASE64_ENC_LAST: ; XH:XL = Pointer FROM BUFFER, YH:YL = Pointer OUT BUFFER, R16:R17 = BUFFER FROM SIZE
PUSH XH
PUSH XL
PUSH YH
PUSH YL
PUSH ZH
PUSH ZL
PUSH R16
PUSH R17
PUSH R18
PUSH R19
PUSH R21
PUSH R22
PUSH R23
PUSH R24
PUSH R25	
	
	LDI ZH, HIGH(BASE64_CODE)
	LDI ZL, LOW(BASE64_CODE)

	LDI R18, 0
	LDI R19, 1

	LDI R21, 3
	LDI R22, 6
	LDI R23, 0
	CLR R25

	BASE64_ENC_LAST_LOOP1:
		CPI R22, 0x00
		BRNE BASE64_ENC_LAST_WRITEBYTE_END
			PUSH R16
			PUSH R17
				CLR R16
				MOV R17, R25
				RCALL PGM_READ_BYTE ;ZH:ZL = Pointer Address, R16:R17 = Byte Adress
				ST Y+, R0
				DEC R21
			POP R17
			POP R16
			LDI R22, 6
			CLR R25
		BASE64_ENC_LAST_WRITEBYTE_END:

		CPI R23, 0x00
		BRNE BASE64_ENC_LAST_READBYTE_END
		LD R24, X+

		SUB R17, R19
		SBC R16, R18
		CP R17, R18
		CPC R16, R18
		;CPI R24, 0x00
		BRNE BASE64_ENC_LAST_STRNOEND
			CPI R22, 6
			BREQ BASE64_ENC_LAST_URL_NOLAST

			BASE64_ENC_LAST_LAST:
				LSL R25
				DEC R22		
			BRNE BASE64_ENC_LAST_LAST
			PUSH R16
			PUSH R17
				CLR R16
				MOV R17, R25
				RCALL PGM_READ_BYTE ;ZH:ZL = Pointer Address, R16:R17 = Byte Adress
				ST Y+, R0	
			POP R17
			POP R16
			BASE64_ENC_LAST_URL_NOLAST:
			DEC R21
		RJMP BASE64_ENC_LAST_END
		BASE64_ENC_LAST_STRNOEND:
		LDI R23, 8
		BASE64_ENC_LAST_READBYTE_END:

		CPI R21, 0x00
		BRNE BASE64_ENC_LAST_PADCOUNT_RESET2
			LDI R21, 3
		BASE64_ENC_LAST_PADCOUNT_RESET2:

		; Schift
		LSL R24
		ROL R25

		DEC R23
		DEC R22
	RJMP BASE64_ENC_LAST_LOOP1
	BASE64_ENC_LAST_END:

	CPI R21, 0x00
	BRLO BASE64_ENC_LAST_PADD_LOOP_END
	BREQ BASE64_ENC_LAST_PADD_LOOP_END
	BRMI BASE64_ENC_LAST_PADD_LOOP_END
	BASE64_ENC_LAST_PADD_LOOP:
		LDI R24, '='
		ST Y+, R24
		DEC R21
	BRNE BASE64_ENC_LAST_PADD_LOOP
	BASE64_ENC_LAST_PADD_LOOP_END:
	LDI R24, 0x00
	ST Y+, R24
POP R25
POP R24
POP R23
POP R22
POP R21
POP R19
POP R18
POP R17
POP R16
POP ZL
POP ZH
POP YL
POP YH
POP XL
POP XH
RET

BASE64_DEC_URL: ; XH:XL = Pointer BASE64 CODE, YH:YL = Pointer OUT STRING
PUSH XH
PUSH XL
PUSH YH
PUSH YL
PUSH ZH
PUSH ZL
PUSH R22
PUSH R23
PUSH R24
PUSH R17
PUSH R16
	LDI ZH, HIGH(BASE64_CODE)
	LDI ZL, LOW(BASE64_CODE)

	LDI R22, 0
	LDI R23, 8

	BASE64_DEC_URL_LOOP:
		CPI R22, 0x00
		BRNE BASE64_DEC_URL_READ_END
		BASE64_DEC_URL_READ:
			LD R16, X+ 
			CPI R16, 0x00
			BREQ BASE64_DEC_URL_END

			CPI R16, '='
			BREQ BASE64_DEC_URL_END

			RCALL PGM_FIND_CHAR ; (Z) Pointer PGM, R16 = CHAR to FIND, R0:R1 = CHAR POS
			TST R0
			BRMI BASE64_DEC_URL_END
			LSL R1
			LSL R1
			LDI R22, 6
		BASE64_DEC_URL_READ_END:

		CPI R23, 0x00
		BRNE BASE64_DEC_URL_WRITE_END
		BASE64_DEC_URL_WRITE:
			ST Y+, R24
			LDI R23, 8
		BASE64_DEC_URL_WRITE_END:
		LSL R1
		ROL R24

		DEC R22
		DEC R23
		RJMP BASE64_DEC_URL_LOOP
	BASE64_DEC_URL_END:
		LDI R24 ,0x00
		ST Y+, R24
POP R16
POP R17
POP R24
POP R23
POP R22
POP ZL
POP ZH
POP YL
POP YH
POP XL
POP XH
RET

; (Base64 code block size must be divisible by 4) + NULL Terminated
; (except the last block) + NULL Terminated
BASE64_DEC_BLOCK: ; XH:XL = Pointer BASE64 CODE, YH:YL = Pointer OUT STRING
PUSH XH
PUSH XL
PUSH YH
PUSH YL
PUSH ZH
PUSH ZL
PUSH R21
PUSH R22
PUSH R23
PUSH R24
PUSH R17
PUSH R16
	LDI ZH, HIGH(BASE64_CODE)
	LDI ZL, LOW(BASE64_CODE)

	LDI R22, 0
	LDI R23, 8

	CLR R0
	CLR R1

	BASE64_DEC_BLOCK_LOOP:
		CPI R22, 0x00
		BRNE BASE64_DEC_BLOCK_READ_END
		BASE64_DEC_BLOCK_READ:
			LD R16, X+ 
			CPI R16, 0x00
			BREQ BASE64_DEC_BLOCK_END

			CPI R16, '='
			BREQ BASE64_DEC_BLOCK_FINISH
			
			PUSH R0
			PUSH R1
				RCALL PGM_FIND_CHAR ; (Z) Pointer PGM, R16 = CHAR to FIND, R0:R1 = CHAR POS
				TST R0
				BRMI BASE64_DEC_BLOCK_END
				MOV R21, R1
			POP R1
			POP R0

			LSL R21
			LSL R21
			LDI R22, 6
		BASE64_DEC_BLOCK_READ_END:

		CPI R23, 0x00
		BRNE BASE64_DEC_BLOCK_WRITE_END
		BASE64_DEC_BLOCK_WRITE:
			ST Y+, R24

			LDI R24, 0x01
			ADD R1, R24
			LDI R24, 0x00
			ADC R0, R24

			LDI R23, 8
		BASE64_DEC_BLOCK_WRITE_END:
		LSL R21
		ROL R24

		DEC R22
		DEC R23
		RJMP BASE64_DEC_BLOCK_LOOP
	BASE64_DEC_BLOCK_FINISH:
		LDI R24 ,0x00
	RJMP BASE64_DEC_BLOCK_END_END
	BASE64_DEC_BLOCK_END:
		ST Y+, R24
		LDI R24, 0x01
		ADD R1, R24
		LDI R24, 0x00
		ADC R0, R24
	BASE64_DEC_BLOCK_END_END:
POP R16
POP R17
POP R24
POP R23
POP R22
POP R21
POP ZL
POP ZH
POP YL
POP YH
POP XL
POP XH
RET
.endif